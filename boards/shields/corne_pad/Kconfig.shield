## boards/shields/corne_pad/Kconfig.shield
```kconfig
# No whitespace after the comma or in your keyboard name!
config SHIELD_CORNE_PAD_LEFT
    def_bool $(shields_list_contains,corne_pad_left)

config SHIELD_CORNE_PAD_RIGHT
    def_bool $(shields_list_contains,corne_pad_right)
```
